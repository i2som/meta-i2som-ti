## conf/bblayers.conf.sample
```bitbake
# POKY_BBLAYERS_CONF_VERSION is increased each time build/conf/bblayers.conf
# changes incompatibly
POKY_BBLAYERS_CONF_VERSION = "2"

BBPATH = "${TOPDIR}"
BBFILES ?= ""

OEROOT := "${@os.path.abspath(os.path.dirname(d.getVar('FILE', True)) + '/../..')}"
BBLAYERS  ?= " \
  ${OEROOT}/sources/poky/meta \
  ${OEROOT}/sources/poky/meta-poky \
  ${OEROOT}/sources/meta-openembedded/meta-oe \
  ${OEROOT}/sources/meta-openembedded/meta-networking \
  ${OEROOT}/sources/meta-openembedded/meta-python \
  ${OEROOT}/sources/meta-openembedded/meta-multimedia \
  "
BBLAYERS += "\
    ${OEROOT}/sources/meta-gstreamer1.0 \
    ${OEROOT}/sources/meta-nodejs \
    ${OEROOT}/sources/meta-qt5 \
    ${OEROOT}/sources/meta-ti \
    ${OEROOT}/sources/meta-swupdate \
    ${OEROOT}/sources/meta-i2som-ti \
    ${OEROOT}/sources/meta-i2som-yocto \
    "
```

## conf/layer.conf
```bitbake
# We have a conf and classes directory, add to BBPATH
BBPATH .= ":${LAYERDIR}"

# We have a recipes directory, add to BBFILES
BBFILES += "${LAYERDIR}/recipes-*/*/*.bb \
            ${LAYERDIR}/recipes-*/*/*.bbappend"


BBFILE_COLLECTIONS += "i2som-ti"
BBFILE_PATTERN_i2som-ti = "^${LAYERDIR}/"
BBFILE_PRIORITY_i2som-ti = "20"
LAYERVERSION_i2som-ti = "2"
LAYERDEPENDS_i2som-ti = "core"

# Additional license directories.
LICENSE_PATH += "${LAYERDIR}/licenses"
```

## conf/machine/i2cam335xbn.conf
```bitbake
#@TYPE: Machine
#@NAME: i2C-AM335x
#@DESCRIPTION: i2SOM i2C-AM335x board with i2S-AM335x SoM

include conf/machine/include/i2s-am335x.inc
include conf/machine/include/i2s-am335x-nand.inc

SOC_FAMILY .= ":i2sam335x"

# U-Boot 
UBOOT_CONFIG ??= "nand"
UBOOT_CONFIG[nand] = "i2s_am335x_nand_defconfig"

# Kernel
KERNEL_DEVICETREE = "i2cam335x-i2sam335x-nand.dtb"

# Normally AM335 boards use ttyS0, but ICE uses ttyS3, so try both
#SERIAL_CONSOLE = ""
#SERIAL_CONSOLES = "115200;ttyO0"
#SERIAL_CONSOLES_CHECK = "${SERIAL_CONSOLES}"

# UBI information.  Note that this is board and kernel specific.  Changes
# in your kernel port may require changes in these variables.  For more
# details about this board please see
# http://processors.wiki.ti.com/index.php/UBIFS_Support

# do ubiattach /dev/ubi_ctrl -m 7 -O 2048
# From dmesg:
# UBI: smallest flash I/O unit:    2048
# UBI: logical eraseblock size:    126976 bytes
# from ubiattach stdout:
# UBI device number 0, total 1988 LEBs
#MKUBIFS_ARGS = "-F -m 2048 -e 126976 -c 8000"
#MKUBIFS_ARGS ?= "-F -m 2048 -e 126976 -c 2048"

# do ubiattach /dev/ubi_ctrl -m 7 -O 2048
# from dmesg:
# UBI: smallest flash I/O unit:    2048
# UBI: physical eraseblock size:   131072 bytes (128 KiB)
# UBI: sub-page size:              512
# UBI: VID header offset:          2048 (aligned 2048)
#UBINIZE_ARGS = "-m 2048 -p 128KiB -s 512 -O 2048"
# resistivetouch, the rdk has one attached
MACHINE_FEATURES += "resistivetouch wifi sgx suspend"

IMAGE_CLASSES = "image_types_i2som"
IMAGE_FSTYPES += "ubi ubifs tar.bz2 linux.fit boot.mlo boot.uboot"
```

## conf/machine/include/i2s-am335x-nand.inc
```bitbake
# rootfs images
# Use the expected value of the ubifs filesystem's volume name in the kernel
UBI_VOLNAME = "rootfs"
# The biggest NANDs on current modules are 1GB. With current partition layout,
# this sums up to 7943 LEBs available for the ubifs
MKUBIFS_ARGS = "-F -m 2048 -e 126976 -c 2048"
UBINIZE_ARGS = "-m 2048 -p 0x20000 -s 512 -O 2048"

# mkfs.ubifs parameters for boot.ubifs file (kernel and device tree files)
MKUBIFS_BOOT_ARGS ?= "-m 2048 -e 126976 -c 127"
MKUBIFS_RECOVERY_ARGS ?= "-m 2048 -e 126976 -c 151"
```

## conf/machine/include/i2s-am335x.inc
```bitbake
#Taken from TI yocto BSP Layer Version 05-2014, original name:ti33xx.inc
SOC_FAMILY = "ti33x"
require conf/machine/include/soc-family.inc
DEFAULTTUNE ?= "cortexa8thf-neon"
require conf/machine/include/tune-cortexa8.inc
# List common SoC features
MACHINE_FEATURES = "kernel26 apm usbgadget usbhost vfat ext2 screen alsa ethernet can sgx"

PREFERRED_VERSION_gcc ?= "6.%"
PREFERRED_VERSION_gcc-cross-${TARGET_ARCH} ?= "6.%"
PREFERRED_VERSION_gcc-runtime ?= "6.%"

# Sub-architecture support adapted fom fsl-arm
MACHINE_SOCARCH = "${TUNE_PKGARCH}-ti33x"
PACKAGE_EXTRA_ARCHS_append = " ${MACHINE_SOCARCH}"

# Bootloader
PREFERRED_PROVIDER_virtual/bootloader = "u-boot-i2som"
#PREFERRED_PROVIDER_u-boot = "u-boot-i2som"

UBOOT_ARCH = "arm"
#UBOOT_MACHINE = "i2s_am335x_emmc_defconfig"

UBOOT_ENTRYPOINT = "0x80008000"
UBOOT_LOADADDRESS = "0x80008000"


# Kernel
PREFERRED_PROVIDER_virtual/kernel = "linux-i2som"
KERNEL_IMAGETYPE ?= "zImage"
# Install modules in initramfs and rootfs
#PACKAGE_INSTALL_append = " kernel-modules"
KERNEL_MODULE_AUTOLOAD += " cryptodev"

SERIAL_CONSOLES ?= "115200;ttyO0"
# dont install kernelimage to rootfs
RDEPENDS_kernel-base = ""

# rootfs images
# Use the expected value of the ubifs filesystem's volume name in the kernel
UBI_VOLNAME = "rootfs"
# The biggest NANDs on current modules are 1GB. With current partition layout,
# this sums up to 7943 LEBs available for the ubifs
MKUBIFS_ARGS = "-F -m 2048 -e 126976 -c 2048"
UBINIZE_ARGS = "-m 2048 -p 0x20000 -s 512 -O 2048"

# xserver
PREFERRED_PROVIDER_virtual/xserver ?= "xserver-xorg"
# For built-in LCD, add xf86-input-tslib
XSERVER = "xserver-xorg \
           xf86-input-evdev \
           xf86-input-mouse \
           xf86-video-fbdev \
           xf86-input-keyboard"
# Default to external video, change to smallscreen for built-in LCD
GUI_MACHINE_CLASS = "smallscreen"

# OpenGLES support for AM335x SGX Core
PREFERRED_PROVIDER_virtual/libgles1 ?= "ti-sgx-ddk-um"
PREFERRED_PROVIDER_virtual/libgles2 ?= "ti-sgx-ddk-um"
PREFERRED_PROVIDER_virtual/egl ?= "ti-sgx-ddk-um"

QT_QPA_DEFAULT_PLATFORM ?= "${@bb.utils.contains('MACHINE_FEATURES', 'sgx', 'eglfs', 'linuxfb', d)}"

# default images to build
IMAGE_FSTYPES ?= "tar.gz ubifs ext4 ubi"
```
